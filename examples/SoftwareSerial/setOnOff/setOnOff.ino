// ПРИМЕР УПРАВЛЕНИЯ РОЗЕТКОЙ:                                                     //
                                                                                   //
#include <SoftwareSerial.h>                                                        //   Подключаем библиотеку для работы с программной шиной UART.
#include <iarduino_Modbus.h>                                                       //   Подключаем библиотеку для работы по протоколу Modbus.
#include <iarduino_MB_Socket.h>                                                    //   Подключаем библиотеку для работы с розеткой.
                                                                                   //
SoftwareSerial     rs485(8,9);                                                     //   Создаём объект для работы с программной шиной UART-RS485 указывая выводы RX, TX.
ModbusClient       modbus(rs485, 2);                                               //   Создаём объект для работы по протоколу Modbus указывая объект программной шины UART-RS485 и вывод DE конвертера UART-RS485.
iarduino_MB_Socket socket(modbus);                                                 //   Создаём объект для работы с розеткой указывая объект протокола Modbus.
                                                                                   //
void setup(){                                                                      //
     Serial.begin(9600);   while(!Serial);                                         //   Инициируем передачу данных в монитор последовательного порта, указав его скорость.
     rs485.begin(9600); // while(!rs485 );                                         //   Инициируем работу с программной шиной UART-RS485 указав её скорость.
     modbus.begin();                                                               //   Инициируем работу по протоколу Modbus.
//   modbus.setTimeout(10);                                                        //   Указываем максимальное время ожидания ответа по протоколу Modbus.
//   modbus.setDelay(4);                                                           //   Указываем минимальный интервал между отправляемыми сообщениями по протоколу Modbus.
//   modbus.setTypeMB( MODBUS_RTU );                                               //   Указываем тип протокола Modbus: MODBUS_RTU (по умолчанию), или MODBUS_ASCII.
     socket.begin(1);                                                              //   Инициируем работу с розеткой, указав её адрес.
}                                                                                  //   Если адрес не указан socket.begin(), то он будет найден, но это займёт некоторое время.
                                                                                   //
void loop(){                                                                       //
     int i;                                                                        //
//   Включаем розетку:                                                             //
     i=socket.setState(true);                                                      //   Отправляем команду включения розетки.
     if( i==false ){ Serial.println("Розетка не включилась"); }                    //   Выводим информацию об ошибке.
//   Проверяем состояние розетки:                                                  //
     i=socket.getState();                                                          //   Получаем состояние розетки.
     if( i==1 ){ Serial.println("Розетка включена" ); }else                        //   Выводим  состояние розетки.
     if( i==0 ){ Serial.println("Розетка отключена"); }else                        //   Выводим  состояние розетки.
               { Serial.println("Состояние розетки неизвестно" ); }                //   Выводим  состояние розетки.
     delay(1000);                                                                  //   Ждём 1 секунду.
//   Отключаем розетку:                                                            //
     i=socket.setState(false);                                                     //   Отправляем команду отключения розетки.
     if( i==false ){ Serial.println("Розетка не выключилась"); }                   //   Выводим информацию об ошибке.
//   Проверяем состояние розетки:                                                  //
     i=socket.getState();                                                          //   Получаем состояние розетки.
     if( i==1 ){ Serial.println("Розетка включена" ); }else                        //   Выводим  состояние розетки.
     if( i==0 ){ Serial.println("Розетка отключена"); }else                        //   Выводим  состояние розетки.
               { Serial.println("Состояние розетки неизвестно" ); }                //   Выводим  состояние розетки.
     delay(1000);                                                                  //   Ждём 1 секунду.
}                                                                                  //